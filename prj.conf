## CMakeLists.txt
```
# SPDX-License-Identifier: Apache-2.0

cmake_minimum_required(VERSION 3.20.0)
find_package(Zephyr REQUIRED HINTS $ENV{ZEPHYR_BASE})
project(sensor)

target_sources(app
    PRIVATE
        src/main.c
        src/app_bt.c
    )
```

## prj.conf
```kconfig
CONFIG_GPIO=y
CONFIG_NEWLIB_LIBC=y

# Output uart
CONFIG_LOG=y
CONFIG_LOG_DEFAULT_LEVEL=4
CONFIG_LOG_BACKEND_UART=y
CONFIG_PRINTK=y

CONFIG_BT=y
CONFIG_BT_PERIPHERAL=y
CONFIG_BT_DEVICE_NAME="microbit_v2"
```

## bbc_microbit_v2.overlay
```dts
// To get started, press Ctrl+Space to bring up the completion menu and view the available nodes.

// You can also use the buttons in the sidebar to perform actions on nodes.
// Actions currently available include:

// * Enabling / disabling the node
// * Adding the bus to a bus
// * Removing the node
// * Connecting ADC channels

// For more help, browse the DeviceTree documentation at https://docs.zephyrproject.org/latest/guides/dts/index.html
// You can also visit the nRF DeviceTree extension documentation at https://nrfconnect.github.io/vscode-nrf-connect/devicetree/nrfdevicetree.html

/ {
    ring_inputs {
        compatible = "gpio-keys";
        ring0: ring0 {
            gpios = <&gpio0 2 (GPIO_ACTIVE_LOW | GPIO_PULL_UP)>;
            label = "ring0 input";
        };
    };
};
```

## src/main.c
```c
/*
 * Copyright (c) 2016 Intel Corporation
 *
 * SPDX-License-Identifier: Apache-2.0
 */

#include <stdio.h>

#include <device.h>
#include <devicetree.h>
#include <kernel.h>
#include <zephyr.h>
#include <zephyr/drivers/gpio.h>

#include <logging/log.h>
LOG_MODULE_REGISTER(sensor);

#include "app_bt.h"

/* 1000 msec = 1 sec */
#define SLEEP_TIME_MS 1000

static const struct gpio_dt_spec button = GPIO_DT_SPEC_GET(DT_NODELABEL(ring0), gpios);
static struct gpio_callback      button_cb;

static bool is_connected = false;

static void app_send_handler(struct k_work *work);
static void app_update_handler(struct k_work *work);
static void app_timer_handler(struct k_timer *dummy);

K_WORK_DEFINE(app_send, app_send_handler);
K_WORK_DEFINE(app_update, app_update_handler);
K_TIMER_DEFINE(app_timer, app_timer_handler, NULL);

static void button_handler(const struct device *dev, struct gpio_callback *cb, uint32_t pins)
{
    if (pins & BIT(button.pin)) {
        if (is_connected) {
            k_work_submit(&app_send);
        } else {
            k_work_submit(&app_update);
        }
    }
}

static void button_init(void)
{
    gpio_pin_configure_dt(&button, GPIO_INPUT | GPIO_PULL_UP);
    gpio_pin_interrupt_configure_dt(&button, GPIO_INT_EDGE_BOTH);
    gpio_init_callback(&button_cb, button_handler, BIT(button.pin));
    gpio_add_callback(button.port, &button_cb);
}

static void app_send_handler(struct k_work *work)
{
    gpio_pin_interrupt_configure_dt(&button, GPIO_INT_DISABLE);

    uint8_t button_status = gpio_pin_get_dt(&button);
    LOG_INF("app_send_handler(): button_status=%d", button_status);
    bt_app_send_data(button_status);

    gpio_pin_interrupt_configure_dt(&button, GPIO_INT_EDGE_BOTH);
}

static void app_update_handler(struct k_work *work)
{
    gpio_pin_interrupt_configure_dt(&button, GPIO_INT_DISABLE);

    uint8_t button_status = gpio_pin_get_dt(&button);
    LOG_INF("app_update_handler(): button_status=%d", button_status);
    bt_app_advertise_update(button_status);

    gpio_pin_interrupt_configure_dt(&button, GPIO_INT_EDGE_BOTH);
}

static void app_timer_handler(struct k_timer *dummy)
{
    k_work_submit(&app_send);
}

static void connected(struct bt_conn *conn, uint8_t err)
{
    if (err) {
        printk("Connection failed (err %u)\n", err);
        return;
    }

    printk("Connected\n");
    is_connected = true;
}

static void disconnected(struct bt_conn *conn, uint8_t reason)
{
    printk("Disconnected (reason %u)\n", reason);
    is_connected = false;
}

BT_CONN_CB_DEFINE(conn_callbacks) = {
    .connected    = connected,
    .disconnected = disconnected,
};

static int app_bt_cb(void *data)
{
    // Note: The maximum data size is defined by APP_BT_MAX_ATTR_LEN.
    uint8_t button_status = gpio_pin_get_dt(&button);
    memcpy(data, &button_status, sizeof(button_status));
    return sizeof(button_status);
}

static struct bt_app_cb app_callbacks = {
    .app_bt_cb = app_bt_cb,
};

void main(void)
{
    LOG_MODULE_DECLARE(sensor);
    int ret;

    ret = bt_app_init(&app_callbacks);
    if (ret) {
        LOG_ERR("Failed to init bt [%d]", ret);
        return;
    }

    ret = bt_app_advertise_start();
    if (ret) {
        LOG_ERR("Failed to start advertising [%d]", ret);
        return;
    }

    button_init();

    /* start periodic timer that expires once every `SLEEP_TIME_MS` milliseconds */
    k_timer_start(&app_timer, K_SECONDS(1), K_MSEC(SLEEP_TIME_MS));

    // do nothing
}
```

## src/app_bt.c
```c
#include <errno.h>
#include <stddef.h>
#include <string.h>
#include <sys/byteorder.h>
#include <sys/printk.h>
#include <zephyr.h>
#include <zephyr/types.h>

#include <bluetooth/bluetooth.h>
#include <bluetooth/conn.h>
#include <bluetooth/gatt.h>
#include <bluetooth/hci.h>
#include <bluetooth/uuid.h>

#include <logging/log.h>

#include "app_bt.h"

LOG_MODULE_REGISTER(app_bt, CONFIG_LOG_DEFAULT_LEVEL);

static uint8_t button_status = CUSTOM_DATA_BUTTON_OFF;

static bool notify_enabled;
static char char_value[APP_BT_MAX_ATTR_LEN];

static struct bt_app_cb app_cb;

static void app_ccc_cfg_changed(const struct bt_gatt_attr *attr, uint16_t value)
{
    notify_enabled = (value == BT_GATT_CCC_NOTIFY);
}

static ssize_t read_function(
    struct bt_conn *conn, const struct bt_gatt_attr *attr, void *buf, uint16_t len, uint16_t offset
)
{
    LOG_DBG("Attribute read, handle: %u, conn: %p", attr->handle, (void *)conn);

    if (app_cb.app_bt_cb) {
        int data_len = app_cb.app_bt_cb(attr->user_data);
        if (data_len < 0) {
            return data_len;
        }

        return bt_gatt_attr_read(conn, attr, buf, len, offset, attr->user_data, data_len);
    }

    return 0;
}

BT_GATT_SERVICE_DEFINE(
    app_svc, BT_GATT_PRIMARY_SERVICE(APP_BT_UUID_BASE),
    BT_GATT_CHARACTERISTIC(
        APP_BT_UUID_CHAR, BT_GATT_CHRC_READ | BT_GATT_CHRC_NOTIFY, BT_GATT_PERM_READ, read_function, NULL, char_value
    ),
    BT_GATT_CCC(app_ccc_cfg_changed, BT_GATT_PERM_READ | BT_GATT_PERM_WRITE),
);

int bt_app_init(struct bt_app_cb *callbacks)
{
    if (callbacks) {
        app_cb.app_bt_cb = callbacks->app_bt_cb;
    }

    return bt_enable(NULL);
}

int bt_app_send_data(uint8_t data)
{
    if (!notify_enabled) {
        return -EACCES;
    }

    return bt_gatt_notify(NULL, &app_svc.attrs[2], &data, 1);
}

int bt_app_advertise_start(void)
{
    const struct bt_data ad[] = {
        BT_DATA_BYTES(BT_DATA_FLAGS, (BT_LE_AD_GENERAL | BT_LE_AD_NO_BREDR)),
        BT_DATA(BT_DATA_NAME_COMPLETE, DEVICE_NAME, DEVICE_NAME_LEN),
        BT_DATA(BT_DATA_MANUFACTURER_DATA, &button_status, CUSTOM_DATA_SIZE),
    };

    const struct bt_data sd[] = {
        BT_DATA_BYTES(BT_DATA_UUID128_ALL, APP_BT_UUID_BASE_VAL),
    };

    return bt_le_adv_start(BT_LE_ADV_CONN, ad, ARRAY_SIZE(ad), sd, ARRAY_SIZE(sd));
}

int bt_app_advertise_update(uint8_t data)
{
    button_status = data;
    const struct bt_data ad[] = {
        BT_DATA_BYTES(BT_DATA_FLAGS, (BT_LE_AD_GENERAL | BT_LE_AD_NO_BREDR)),
        BT_DATA(BT_DATA_NAME_COMPLETE, DEVICE_NAME, DEVICE_NAME_LEN),
        BT_DATA(BT_DATA_MANUFACTURER_DATA, &button_status, CUSTOM_DATA_SIZE),
    };

    const struct bt_data sd[] = {
        BT_DATA_BYTES(BT_DATA_UUID128_ALL, APP_BT_UUID_BASE_VAL),
    };

    return bt_le_adv_update_data(ad, ARRAY_SIZE(ad), sd, ARRAY_SIZE(sd));
}
```

## src/app_bt.h
```c
#ifndef BT_APP_H_
#define BT_APP_H_

#include <bluetooth/bluetooth.h>
#include <bluetooth/conn.h>
#include <bluetooth/gatt.h>
#include <bluetooth/hci.h>
#include <bluetooth/uuid.h>

#define DEVICE_NAME     CONFIG_BT_DEVICE_NAME
#define DEVICE_NAME_LEN (sizeof(DEVICE_NAME) - 1)

#define CUSTOM_DATA_BUTTON_ON  0x01
#define CUSTOM_DATA_BUTTON_OFF 0x00
#define CUSTOM_DATA_SIZE       1

// random number
#define APP_BT_UUID_BASE_VAL BT_UUID_128_ENCODE(0xc7839aa8, 0x1903, 0x40b5, 0xa8f0, 0x426e09ffb390)
#define APP_BT_UUID_CHAR_VAL BT_UUID_128_ENCODE(0xc7839aa9, 0x1903, 0x40b5, 0xa8f0, 0x426e09ffb390)

#define APP_BT_UUID_BASE BT_UUID_DECLARE_128(APP_BT_UUID_BASE_VAL)
#define APP_BT_UUID_CHAR BT_UUID_DECLARE_128(APP_BT_UUID_CHAR_VAL)

#define APP_BT_MAX_ATTR_LEN 64

typedef int (*app_bt_cb_t)(void *data);

struct bt_app_cb {
    app_bt_cb_t app_bt_cb;
};

/** @brief Initialize the app_bt Service.
 *
 * @param[in] callbacks Struct containing pointers to callback functions
 *			used by the service. This pointer can be NULL
 *			if no callback functions are defined.
 *
 * @retval 0 If the operation was successful.
 *           Otherwise, a (negative) error code is returned.
 */
int bt_app_init(struct bt_app_cb *callbacks);

/** @brief Send data (notify).
 *
 * If the notify is not enabled, the data will be discarded.
 *
 * @param[in] data notify data. Able to input only 1 byte.
 *
 * @retval 0 If the operation was successful.
 *           Otherwise, a (negative) error code is returned.
 */
int bt_app_send_data(uint8_t data);

/** @brief Start advertising.
 *
 * @retval 0 If the operation was successful.
 *           Otherwise, a (negative) error code is returned.
 */
int bt_app_advertise_start(void);

int bt_app_advertise_update(uint8_t data);

#endif
```

## src/led_matrix.c
```c
/*
 * Copyright (c) 2021, Nordic Semiconductor ASA
 *
 * SPDX-License-Identifier: Apache-2.0
 */

#include <zephyr/zephyr.h>
#include <zephyr/sys/printk.h>
#include <zephyr/drivers/display.h>
#include <string.h>

#include "led_matrix.h"

static struct display_capabilities caps;
static uint8_t buf[5];
static const struct display_buffer_descriptor buf_desc = {
	.buf_size = sizeof(buf),
	.width    = 5,
	.height   = 5,
	.pitch    = 8,
};

static const struct device *led_matrix_dev = DEVICE_DT_GET_ONE(nordic_nrf_led_matrix);

static void update_block_3x3(const struct device *dev)
{
	int ret;
	static const uint8_t small_bufs[][2] = {
		{ PIXEL_MASK(0, 1, 0) |
		  PIXEL_MASK(0, 1, 0) << 4,
		  PIXEL_MASK(0, 1, 0) },
		{ PIXEL_MASK(0, 0, 1) |
		  PIXEL_MASK(0, 1, 0) << 4,
		  PIXEL_MASK(1, 0, 0) },
		{ PIXEL_MASK(0, 0, 0) |
		  PIXEL_MASK(1, 1, 1) << 4,
		  PIXEL_MASK(0, 0, 0) },
		{ PIXEL_MASK(1, 0, 0) |
		  PIXEL_MASK(0, 1, 0) << 4,
		  PIXEL_MASK(0, 0, 1) },
	};
	static const struct display_buffer_descriptor small_buf_desc = {
		.buf_size = sizeof(small_bufs[0]),
		.width    = 3,
		.height   = 3,
		.pitch    = 4,
	};

	for (int i = 0; i < 4 * ARRAY_SIZE(small_bufs); ++i) {
		k_sleep(K_MSEC(100));

		ret = display_write(dev, 1, 1,
				    &small_buf_desc, small_bufs[i % 4]);
		if (ret < 0) {
			printk("display_write failed: %u/%d\n",
				__LINE__, ret);
		}
	}
}

static void update_block_5x5(const struct device *dev)
{
	int ret;

	buf[0] = PIXEL_MASK(0, 0, 0, 0, 1);
	buf[1] = PIXEL_MASK(0, 0, 0, 1, 1);
	buf[2] = PIXEL_MASK(0, 0, 1, 1, 1);
	buf[3] = PIXEL_MASK(0, 1, 1, 1, 1);
	buf[4] = PIXEL_MASK(1, 1, 1, 1, 1);
	ret = display_write(dev, 0, 0, &buf_desc, buf);
	if (ret < 0) {
		printk("display_write failed: %u/%d\n",
			__LINE__, ret);
	}

	for (int i = 0; i < 4 * 5; ++i) {
		uint8_t tmp;

		k_sleep(K_MSEC(100));

		tmp = buf[0];
		buf[0] = buf[1];
		buf[1] = buf[2];
		buf[2] = buf[3];
		buf[3] = buf[4];
		buf[4] = tmp;
		ret = display_write(dev, 0, 0, &buf_desc, buf);
		if (ret < 0) {
			printk("display_write failed: %u/%d\n",
				__LINE__, ret);
		}
	}
}

static void show_all_brightness_levels(const struct device *dev)
{
	int ret;
	uint8_t brightness = 0;

	do {
		--brightness;
		ret = display_set_brightness(dev, brightness);
		if (ret < 0) {
			printk("display_set_brightness failed: %u/%d\n",
				__LINE__, ret);
		}

		k_sleep(K_MSEC(5));
	} while (brightness);
}

static void update_through_framebuffer(const struct device *dev)
{
	uint8_t *framebuf = display_get_framebuffer(dev);
	uint8_t dimmed = 0;
	bool inc = false;
	enum {
		MIN_BRIGHTNESS = 0x0F,
		BLOCK_SIZE     = 5,
		STEPS          = BLOCK_SIZE - 1,
		RUNS           = 4
	};

	if (!framebuf) {
		printk("frame buffer not available\n");
		return;
	}

	/* Clear screen. */
	memset(framebuf, 0, caps.x_resolution * caps.y_resolution);

	for (int i = 0; i < 1 + 3 * RUNS * STEPS; ++i) {
		k_sleep(K_MSEC(100));

		for (uint8_t column = 0; column < BLOCK_SIZE; ++column) {
			for (uint8_t row = 0; row < BLOCK_SIZE; ++row) {
				uint8_t diff;
				uint8_t step = (0xFF - MIN_BRIGHTNESS) / STEPS;

				/*
				 * Depending on the iteration, use different
				 * pixel values for:
				 * - vertical lines
				 */
				if (i < 1 * RUNS * STEPS) {
					diff = dimmed > column
					     ? dimmed - column
					     : column - dimmed;
				/*
				 * - horizontal lines
				 */
				} else if (i < 2 * RUNS * STEPS) {
					diff = dimmed > row
					     ? dimmed - row
					     : row - dimmed;
				/*
				 * - diagonal lines
				 */
				} else {
					uint8_t dist = column + row;

					diff = 2 * dimmed > dist
					     ? 2 * dimmed - dist
					     : dist - 2 * dimmed;
					step /= 2;
				}

				framebuf[column + row * caps.x_resolution] =
					MIN_BRIGHTNESS + diff * step;
			}
		}

		if (dimmed == 0 || dimmed == STEPS) {
			inc = !inc;
		}
		if (inc) {
			++dimmed;
		} else {
			--dimmed;
		}
	}
}

int led_matrix_init(void)
{
	int ret;

	display_get_capabilities(led_matrix_dev, &caps);
	if (!(caps.supported_pixel_formats & PIXEL_FORMAT_MONO01)) {
		printk("Expected pixel format not supported\n");
		return -1;
	}

	ret = display_set_pixel_format(led_matrix_dev, PIXEL_FORMAT_MONO01);
	if (ret < 0) {
		printk("display_set_pixel_format failed: %u/%d\n",
			__LINE__, ret);
	}

	ret = display_set_brightness(led_matrix_dev, 0x7F);
	if (ret < 0) {
		printk("display_set_brightness failed: %u/%d\n",
			__LINE__, ret);
	}

	return 0;
}

void led_matrix_set_all(const uint8_t v)
{
	int ret;

	buf[0] = PIXEL_MASK(v, v, v, v, v);
	buf[1] = PIXEL_MASK(v, v, v, v, v);
	buf[2] = PIXEL_MASK(v, v, v, v, v);
	buf[3] = PIXEL_MASK(v, v, v, v, v);
	buf[4] = PIXEL_MASK(v, v, v, v, v);
	ret = display_write(led_matrix_dev, 0, 0, &buf_desc, buf);
	if (ret < 0) {
		printk("display_write failed: %u/%d\n",
			__LINE__, ret);
		return;
	}

	ret = display_blanking_off(led_matrix_dev);
	if (ret < 0) {
		printk("display_blanking_off failed: %u/%d\n",
			__LINE__, ret);
		return;
	}
}

void led_matrix_test(void)
{
	int ret;

	printk("led_matrix_test() Started\n");

	for (;;) {
		ret = display_set_brightness(led_matrix_dev, 0x7F);
		if (ret < 0) {
			printk("display_set_brightness failed: %u/%d\n",
				__LINE__, ret);
		}

		buf[0] = PIXEL_MASK(1, 0, 1, 0, 1);
		buf[1] = PIXEL_MASK(1, 1, 0, 0, 1);
		buf[2] = PIXEL_MASK(1, 0, 1, 0, 1);
		buf[3] = PIXEL_MASK(1, 0, 0, 1, 1);
		buf[4] = PIXEL_MASK(1, 0, 1, 0, 1);
		ret = display_write(led_matrix_dev, 0, 0, &buf_desc, buf);
		if (ret < 0) {
			printk("display_write failed: %u/%d\n",
				__LINE__, ret);
		}

		ret = display_blanking_off(led_matrix_dev);
		if (ret < 0) {
			printk("display_blanking_off failed: %u/%d\n",
				__LINE__, ret);
		}

		k_sleep(K_MSEC(500));

		update_block_3x3(led_matrix_dev);

		k_sleep(K_MSEC(500));

		update_block_5x5(led_matrix_dev);

		k_sleep(K_MSEC(200));

		ret = display_blanking_on(led_matrix_dev);
		if (ret < 0) {
			printk("display_blanking_on failed: %u/%d\n",
				__LINE__, ret);
		}

		k_sleep(K_MSEC(500));

		ret = display_blanking_off(led_matrix_dev);
		if (ret < 0) {
			printk("display_blanking_off failed: %u/%d\n",
				__LINE__, ret);
		}

		k_sleep(K_MSEC(500));

		show_all_brightness_levels(led_matrix_dev);

		update_through_framebuffer(led_matrix_dev);

		k_sleep(K_MSEC(500));
	}
}
```

## src/led_matrix.h
```c
#ifndef LED_MATRIX_H_
#define LED_MATRIX_H_

#define PIXEL_BIT(idx, val)  (val ? BIT(idx) : 0)
#define PIXEL_MASK(...)      (FOR_EACH_IDX(PIXEL_BIT, (|), __VA_ARGS__))

/* size of stack area used by each thread */
#define LED_MATRIX_STACKSIZE 1024

/* scheduling priority used by each thread */
#define LED_MATRIX_PRIORITY 7

int led_matrix_init(void);
void led_matrix_set_all(const uint8_t v);
void led_matrix_test(void);

#endif /* LED_MATRIX_H_ */
```
